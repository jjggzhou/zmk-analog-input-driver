## Kconfig
```kconfig
menuconfig ANALOG_INPUT
    bool "Analog Input Driver"
    help
      Enable analog input driver

if ANALOG_INPUT

config ANALOG_INPUT_MAX_DEVICES
    int "Maximum number of analog input devices"
    default 1
    help
      Maximum number of analog input devices that can be instantiated

config ANALOG_INPUT_LOG_LEVEL
    int "Analog Input log level"
    default 3 if LOG_DEFAULT_LEVEL=3
    default 2 if LOG_DEFAULT_LEVEL=2
    default 1 if LOG_DEFAULT_LEVEL=1
    default 0
    help
      Set log level for analog input driver

config ANALOG_INPUT_REPORT_INTERVAL_MIN
    int "Minimum report interval in milliseconds"
    default 0
    help
      Minimum interval between reports in milliseconds. Set to 0 to disable.

config ANALOG_INPUT_LOG_DBG_RAW
    bool "Enable raw value debug logging"
    default n
    help
      Enable debug logging of raw ADC values

config ANALOG_INPUT_LOG_DBG_REPORT
    bool "Enable report debug logging"
    default n
    help
      Enable debug logging of input reports

config ANALOG_INPUT_WORKQUEUE_STACK_SIZE
    int "Work queue stack size"
    default 1024
    help
      Stack size for the analog input work queue

config ANALOG_INPUT_WORKQUEUE_PRIORITY
    int "Work queue priority"
    default 10
    help
      Priority for the analog input work queue

config ANALOG_INPUT_MAX_CHANNELS
    int "Maximum number of channels per device"
    default 8
    help
      Maximum number of analog input channels per device

config ANALOG_INPUT_CALIBRATION
    bool "Enable runtime calibration support"
    default y
    help
      Enable runtime calibration functionality for analog inputs

config ANALOG_INPUT_CALIBRATION_LOG_LEVEL
    int "Calibration log level"
    default 3 if LOG_DEFAULT_LEVEL=3
    default 2 if LOG_DEFAULT_LEVEL=2
    default 1 if LOG_DEFAULT_LEVEL=1
    default 0
    help
      Set log level for calibration module

config ANALOG_INPUT_CALIBRATION_PERSIST
    bool "Persist calibration data"
    depends on SETTINGS
    default y
    help
      Enable persistent storage of calibration data

endif # ANALOG_INPUT
```

## dts/bindings/zmk,analog-input.yaml
```yaml
# Copyright (c) 2022 The ZMK Contributors
# SPDX-License-Identifier: MIT
description: |
  Input driver for ADC io channel

compatible: "zmk,analog-input"

properties:
  sampling-hz:
    type: int
    default: 100

child-binding:
  description: Per-channel configuration settings
  properties:
    io-channels:
      type: phandle-array
      required: true
    mv-mid:
      type: int
      required: true
      description: |
        Midpoint voltage in mV.
        Set to 32767 (0x7FFF) to enable auto-calibration.
    mv-min-max:
      type: int
      required: true
    mv-deadzone:
      type: int
      default: 10
    invert:
      type: boolean
    report-on-change-only:
      type: boolean
    scale-multiplier:
      type: int
      default: 1
    scale-divisor:
      type: int
      default: 70
    evt-type:
      type: int
      required: true
    input-code:
      type: int
      required: true

    # 校准参数已移至代码中硬编码
    # 请参考 analog_input.h 中的定义：
    # - ANALOG_INPUT_CALIBRATE_SAMPLES
    # - ANALOG_INPUT_CALIBRATE_MAX_RETRIES
    # - ANALOG_INPUT_CALIBRATE_VARIANCE_THRESHOLD
```

## dts/bindings/zmk,behavior-analog-calibrate.yaml
```yaml
# Copyright (c) 2023 The ZMK Contributors
# SPDX-License-Identifier: MIT

description: |
  Analog input calibration behavior.
  
  This behavior triggers calibration of analog input devices when activated.

compatible: "zmk,behavior-analog-calibrate"

properties:
  binding-cells:
    type: int
    required: false
    default: 0
    description: Number of cells in the binding (device index parameter)
```
